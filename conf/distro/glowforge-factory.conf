## conf/distro/glowforge-factory.conf
```bitbake
require conf/distro/include/fslc-base.inc

DISTRO = "glowforge-factory"
DISTRO_NAME = "OpenGlow/Glowforge Factory"
DISTRO_VERSION = "0.0.0"

DISTRO_FEATURES_remove = " \
  3g alsa avahi bluetooth bluez5 ext2 ipv6 irda nfc nfs opengl pci pcmcia \
  pulseaudio vulkan wayland x11 zeroconf "
```
